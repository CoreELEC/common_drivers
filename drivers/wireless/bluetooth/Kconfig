## drivers/wireless/bluetooth/Kconfig
```kconfig
# SPDX-License-Identifier: (GPL-2.0+ OR MIT)

config AMLOGIC_BLUETOOTH
	bool "BT Device support"
	depends on BT && RFKILL
	default n
	help
	  Say Y here if you want to use the BT device.

config AMLOGIC_BT_WAKE_NOT_REPORT
	bool "BT wake up not report key event"
	depends on AMLOGIC_BLUETOOTH
	default n
	help
	  Say Y here if you don't want to help reporting key event
	  when system waken up by BT

config AMLOGIC_LINUX_BT
	bool "Isolate the original GKI net/bluetooth driver code"
	default n
	help
	  Customization and bug fixes for the net/bluetooth driver
	  based on the Linux system.
```

## drivers/i3c/master/Kconfig
```kconfig
# SPDX-License-Identifier: GPL-2.0-only
menu "I3C Hardware Bus support"
	depends on HAS_IOMEM
	depends on I3C
	depends on HAS_IOMEM
	depends on !(ALPHA || PARISC)

config AMLOGIC_I3C
	tristate "Amlogic Meson I3C controller"
	help
	  If you say yes to this option, support will be included for the
	  I3C interface on the Amlogic Meson family of SoCs.

config AMLOGIC_I3C_MASTER
	bool "Amlogic I3C Dual-Role Master driver"
	help
	  Support for Amlogic I3C Dual-Role Master Controller.

endmenu
```

## drivers/iio/adc/Kconfig
```kconfig
# SPDX-License-Identifier: (GPL-2.0+ OR MIT)

menu "Analog to digital converters"

config AMLOGIC_ADC
	tristate "Amlogic ADC devices support"
	default n
	help
	  ADC devices support
	  select y for built-in
	  select m for ko
	  select n for disable

if AMLOGIC_ADC

config AMLOGIC_MESON_SARADC
	bool "Amlogic Meson SAR ADC driver"
	depends on OF && COMMON_CLK
	depends on REGMAP_MMIO
	help
	  Say yes here to build support for the SAR ADC found in Amlogic Meson
	  SoCs.

	  To compile this driver as a module, choose M here: the
	  module will be called meson_saradc.

config AMLOGIC_SARADC_COMMON
	bool "Amlogic SAR ADC common driver"
	depends on OF
	depends on REGMAP_MMIO
	help
	  Say yes here to build support for the SAR ADC common found in Amlogic SoCs.

	  To compile this driver as a module, choose M here: the
	  module will be called amlogic_saradc.

config AMLOGIC_SARADC
	bool "Amlogic SAR ADC driver"
	depends on OF && COMMON_CLK
	depends on REGMAP_MMIO
	help
	  Say yes here to build support for the SAR ADC found in Amlogic SoCs.

	  To compile this driver as a module, choose M here: the
	  module will be called amlogic_saradc.

config AMLOGIC_PDD
	bool "Amlogic PDD (Power Down Detection) driver"
	depends on OF
	depends on REGMAP_MMIO
	depends on IRQ_DOMAIN
	help
	  Say yes here to build support for the PDD found in Amlogic SoCs.

	  To compile this driver as a module, choose M here: the
	  module will be called amlogic_pdd_s7.

config AMLOGIC_SARADC_TO_GPIO
	bool "Amlogic SAR ADC to GPIO driver"
	depends on OF
	depends on GPIOLIB
	help
	  Say yes here to build support for the SAR ADC to GPIO.

	  To compile this driver as a module, choose M here: the
	  module will be called amlogic_saradc_to_gpio.

endif # AMLOGIC_ADC

endmenu
```

## drivers/media/dpss/Kconfig
```kconfig
# SPDX-License-Identifier: (GPL-2.0+ OR MIT)
#
# Dpss driver configuration
#

menu "DI_MULTI driver"

config AMLOGIC_MEDIA_DPSS
	tristate "DPSS driver"
	default n
	help
		Select to enable AMLOGIC DPSS driver
		process interlace source need three continued fields,
		wave progressive source with two interlace fields from
		one progressive fields
endmenu
```

## drivers/media/video_processor/video_dev/Kconfig
```kconfig
# SPDX-License-Identifier: (GPL-2.0+ OR MIT)

#
# Amlogic video2 device configuration
#

menu "V4L2 Video Support"

config AMLOGIC_V4L_VIDEO
		tristate "Amlogic v4l video device support"
		depends on VIDEO_DEV
		default n
		help
				Select to enable "Amlogic v4l video device support.

config AMLOGIC_V4L_VIDEO2
		tristate "Amlogic v4l video2 device support"
		depends on VIDEO_DEV
		depends on AMLOGIC_MEDIA_COMMON
		depends on AMLOGIC_MEDIA_GE2D
		default n
		help
				Select to enable "Amlogic v4l video2 device support.

endmenu
```

## drivers/media/vout/Kconfig
```kconfig
# SPDX-License-Identifier: (GPL-2.0+ OR MIT)
#
# Amlogic vout driver configuration
#

menu "Amlogic Vout Driver Support"

config AMLOGIC_VOUT
	bool "Amlogic Vout Driver"
	default n
	help
		Amlogic Video output module support.
		Vout module includes HDMI-TX, CVBS, PANEL(LCD, backlight) etc.
		Also provide display mode service for all the display modules.
		Amlogic Video output module support.
		Vout module includes HDMI-TX, CVBS, PANEL(LCD, backlight) etc.
		Also provide display mode service for all the display modules.

if AMLOGIC_VOUT
source "$(COMMON_DRIVERS_DIR)/drivers/media/vout/vclk_serve/Kconfig"
source "$(COMMON_DRIVERS_DIR)/drivers/media/vout/vout_serve/Kconfig"
source "$(COMMON_DRIVERS_DIR)/drivers/media/vout/panel_utils/Kconfig"
source "$(COMMON_DRIVERS_DIR)/drivers/media/vout/backlight/Kconfig"
source "$(COMMON_DRIVERS_DIR)/drivers/media/vout/eDPTX/Kconfig"
source "$(COMMON_DRIVERS_DIR)/drivers/media/vout/lcd/Kconfig"
source "$(COMMON_DRIVERS_DIR)/drivers/media/vout/peripheral_lcd/Kconfig"
source "$(COMMON_DRIVERS_DIR)/drivers/media/vout/dsc/Kconfig"
source "$(COMMON_DRIVERS_DIR)/drivers/media/vout/hdmi_tx_connector/Kconfig"
source "$(COMMON_DRIVERS_DIR)/drivers/media/vout/meson_tx_connector/Kconfig"
source "$(COMMON_DRIVERS_DIR)/drivers/media/vout/cvbs/Kconfig"
source "$(COMMON_DRIVERS_DIR)/drivers/media/vout/vdac/Kconfig"
endif

endmenu
```

## drivers/media/vout/eDPTX/Kconfig
```kconfig
# SPDX-License-Identifier: (GPL-2.0+ OR MIT)

#
# Video output configuration
#
menu "Amlogic embedded DisplayPort Output Module"

config AMLOGIC_eDPTX
	bool "embedded DisplayPort Output Module"
	default n
	help
		Support for eDP output

endmenu
```

## drivers/media/vout/lcd/Kconfig
```kconfig
# SPDX-License-Identifier: (GPL-2.0+ OR MIT)

#
# Video output configuration
#
menu "Amlogic LCD Output Module"

config AMLOGIC_LCD
	bool "LCD Output Module"
	default n
	help
		LCD output module
		Include LVDS, MIPI-DPI

config AMLOGIC_LCD_DPI
	bool "LCD DPI Output Module"
	default n
	depends on AMLOGIC_LCD
	help
		LCD DPI output module (rgb, bt656, bt2020)
		Configure the LCD output model for DPI output

config AMLOGIC_LCD_LVDS
	bool "LCD LVDS Output Module"
	default n
	depends on AMLOGIC_LCD
	help
		LCD LVDS output module
		Configure the LCD output model for LVDS output

config AMLOGIC_LCD_VBYONE
	bool "LCD V-BY-ONE Output Module"
	default n
	depends on AMLOGIC_LCD
	help
		LCD V-BY-ONE output module
		Configure the LCD output model for V-BY-ONE output

config AMLOGIC_LCD_TCON
	bool "LCD TCON Output Module"
	default n
	depends on AMLOGIC_LCD
	help
		LCD tcon output module
		Configure the LCD output model for tcon output

config AMLOGIC_LCD_MIPI_DSI
	bool "LCD MIPI_DSI Output Module"
	default n
	depends on AMLOGIC_LCD
	help
		LCD MIPI_DSI output module
		Configure the LCD output model for MIPI_DSI output

config AMLOGIC_LCD_CLK_SOC
	bool "Control lcd_clk_xxx file to build"
	default AMLOGIC_LCD
	depends on !AMLOGIC_C3_REMOVE
	help
	        Control lcd_clk_xxx file to build with AMLOGIC_C3_REMOVE

if AMLOGIC_LCD
source "$(COMMON_DRIVERS_DIR)/drivers/media/vout/backlight/Kconfig"
source "$(COMMON_DRIVERS_DIR)/drivers/media/vout/lcd/lcd_extern/Kconfig"
source "$(COMMON_DRIVERS_DIR)/drivers/media/vout/lcd/ambilight/Kconfig"
endif

endmenu
```

## drivers/media/vout/panel_utils/Kconfig
```kconfig
# SPDX-License-Identifier: (GPL-2.0+ OR MIT)

#
# Backlight configuration
#
menu "Amlogic Backlight Support"

config AMLOGIC_Panel_Utils
	bool "Amlogic Panel(lcd/eDP/Backlight) Utils support"
	default n
	help
		Say Y here if you want to use the Amlogic Panel.
		Basic Support for panel driver.

endmenu
```

## drivers/memory_ext/Kconfig
```kconfig
# SPDX-License-Identifier: (GPL-2.0+ OR MIT)

menuconfig AMLOGIC_MEMORY_EXTEND
	bool "AMLOGIC memory extend support"
	depends on AMLOGIC_DRIVER
	depends on AMLOGIC_BREAK_GKI_20
	select SWIOTLB if !AMLOGIC_ZAPPER_CUT
	select DMA_RESTRICTED_POOL if !AMLOGIC_ZAPPER_CUT
	default n
	help
		Amlogic memory extend is drivers which extend for memory management
		functions, can be used for memory debug or other features.

config AMLOGIC_MIX_ZRAM
	tristate "Amlogic mixed zram"
	depends on AMLOGIC_MEMORY_EXTEND
	depends on CRYPTO_ZSTD
	depends on CRYPTO_LZ4
	default n
	help
		Mix compress algorithm of zram. This can get speed benifit of lz4 and
		compress ratio of zstd.

config AMLOGIC_PAGE_TRACE
	tristate "Amlogic trace for page allocate"
	depends on KALLSYMS
	depends on !NUMA_BALANCING
	default n
	help
		Amlogic page trace will record function address of caller for page
		allocate/free, according with allocate flags and order. trace
		information is stored in a pre-allocated memory block. And can be shown
		with allocate page count information of each caller functions from
		/proc/pagetrace

config AMLOGIC_PAGE_TRACE_INLINE
	bool "page trace inline into page flags"
	depends on AMLOGIC_BREAK_GKI
	depends on AMLOGIC_PAGE_TRACE
	depends on 64BIT
	depends on !KASAN_HW_TAGS && !KASAN_SW_TAGS
	default n
	help
		This feature enable to inline page trace into high 32bits of
		page->flags on 64 bit kernel. Because other total page flags
		are less than 32bit, so It can help to save memory when
		use page trace. But it conflict with KASAN tags, so when kasan
		tags enabled, this feature will be auto disabled

config AMLOGIC_CMA
	tristate "Amlogic CMA change"
	depends on CMA
	default n
	help
		Amlogic CMA optimization for cma alloc/free problems
		Including policy change of CMA usage

config AMLOGIC_NO_CMA
	tristate "Amlogic CMA change, add no cma flag"
	depends on CMA
	depends on AMLOGIC_CMA
	default n
	help
		Amlogic CMA optimization for cma alloc/free problems
		Including policy change of CMA usage, add no cma flag
		to avoid page not in cma pool.

config AMLOGIC_CMA_INFO
	tristate "Amlogic CMA change, add debug information"
	depends on CMA
	depends on AMLOGIC_CMA
	default n
	help
		Amlogic CMA optimization for cma alloc/free problems
		Including policy change of CMA usage, add more debug
		information in cma alloc/free flow.

config AMLOGIC_MEM_DEBUG
	tristate "Amlogic debug mem"
	default n
	help
		Memory debug which hacking to kernel mm source.

config AMLOGIC_STACKPROTECTOR
	bool "Amlogic stack protector"
	depends on AMLOGIC_MEMORY_EXTEND
	default n
	help
		This config is used to disable CONFIG_STACKPROTECTOR
		if enabled AMLOGIC_VMAP. CONFIG_STACKPROTECTOR have
		bad effect to save stack usage.

config AMLOGIC_PTR_AUTH_KERNEL
	bool "Amlogic arm64 ptr auth kernel"
	depends on AMLOGIC_MEMORY_EXTEND
	default n
	help
		This config is used to disable CONFIG_ARM64_PTR_AUTH_KERNEL.
		if enabled AMLOGIC_VMAP, CONFIG_ARM64_PTR_AUTH_KERNEL not
		allow to modify stack pointer.

config AMLOGIC_VMAP
	bool "Amlogic kernel stack"
	depends on AMLOGIC_MEMORY_EXTEND
	depends on AMLOGIC_BREAK_GKI
	depends on AMLOGIC_STACKPROTECTOR
	depends on !AMLOGIC_ARM_KASAN
	depends on AMLOGIC_PTR_AUTH_KERNEL || ARM
	default n
	help
		This config is used to enable amlogic kernel stack
		usage optimization with vmalloc. It depends on
		AMLOGIC_MEMORY_EXTEND. This config only opened
		on 64 bit platform.

config AMLOGIC_VMAP_CACHE_PAGE_ORDER
	int "Amlogic kernel stack cache page order"
	depends on AMLOGIC_VMAP
	default "8"
	help
		This config is used to set vmap stack cache
		page order, default order is 8, some projects
		can be modified appropriately.

config AMLOGIC_USER_FAULT
	tristate "Amlogic user fault helper"
	default n
	help
		show more information when catch user fault. Including:
		memory around all registers
		maps with pc/lr
		pfn for all virtual address of registers

config AMLOGIC_ZSTD
	tristate "Amlogic zstd optimize"
	depends on AMLOGIC_BREAK_GKI_20
	depends on AMLOGIC_MEMORY_EXTEND
	default n
	help
		This config is an optimization of zstd,
		in zram, to improve the compression ratio
		and save memory

config AMLOGIC_MEMORY_STAT
	bool "Amlogic stat memory info"
	depends on AMLOGIC_BREAK_GKI
	depends on AMLOGIC_MEMORY_EXTEND
	default n
	help
		This config use to stat memory info,
		include count free pages in migrate
		list, print more memory information.

config AMLOGIC_CMA_DIS
	bool "Amlogic CMA disable change fot gki"
	depends on AMLOGIC_MEMORY_EXTEND
	depends on CMA
	default n
	help
		Amlogic disable CMA optimization for gki needs.

config AMLOGIC_MEMORY_OPT
	bool "Amlogic memory optimization support"
	depends on AMLOGIC_MEMORY_EXTEND
	default n
	help
		Amlogic memory optimization support,
		distinguish from AMLOGIC_MEMORY_EXTEND,
		because of gki requirements, enable in
		aarch32.

config AMLOGIC_PIN_LOCKED_FILE
	bool "Amlogic pin locked file"
	depends on AMLOGIC_BREAK_GKI
	depends on AMLOGIC_MEMORY_EXTEND
	default n
	help
		If we pin a file in android, the whole daa of this
		file will be loaded to DDR, but most of these data
		may not be used, this caused memory waste.
		delay mark mlocked flags for unevictable pages until
		it has been faulted.

config AMLOGIC_PIN_LOCKED_FILE_V2
	bool "Amlogic pin locked file new version"
	depends on AMLOGIC_BREAK_GKI
	depends on AMLOGIC_MEMORY_EXTEND
	default n
	help
		If we pin a file in android, the whole daa of this
		file will be loaded to DDR, but most of these data
		may not be used, this caused memory waste.
		delay mark mlocked flags for unevictable pages until
		it has been faulted.

config AMLOGIC_PCIE_DMA_OPS
	tristate "Amlogic PCIE dma_ops"
	depends on AMLOGIC_MEMORY_EXTEND
	select DMA_DIRECT_REMAP if AMLOGIC_BREAK_GKI
	select SWIOTLB if AMLOGIC_BREAK_GKI
	default n
	help
		custom a dma_ops to limit the memory for PCIE device
		operations to a fixed area

config AMLOGIC_FAKE_SMMU
	tristate "Amlogic fake smmu"
	depends on IOMMU_SUPPORT
	default n
	help
		Register a fake smmu device to replace ops for 64bit

config AMLOGIC_ARM_KASAN
	bool "support arm kasan"
	depends on KASAN
	depends on ARM
	default y
	help
		Support enable kasan on arm32

config AMLOGIC_DTB_NODE_OPT
	bool "remove dtb node optimization"
	default n
	help
		some project to optimize the slab size, remove the
		dtb node under /sys/firmware/devicetree directory.

config AMLOGIC_KALLSYM_OPT
	bool "kallsyms optimization"
	default n
	help
		some project to optimize the kallsyms.

config AMLOGIC_PRINTK_OPT
	bool "printk optimization"
	default n
	help
		some project to optimize the printk, reduce the
		log buffer size.

config AMLOGIC_KHEADERS_OPT
	bool "kheaders optimization"
	default n
	help
		some project to remove the kheaders, reduce the
		kernel image size.

config AMLOGIC_MEMORY_SLAB_LARGE
	tristate "large kmalloc optimization"
	default n
	help
		kmalloc defaults to order alignment, change it
		to page alignment to reduce memory usage.

config AMLOGIC_SWAPD_OPT
	bool "filecache reclaim optimization"
	default n
	help
		for filecache with many references, do not
		recycle them to reduce memory thrashing.
```

## drivers/mmc/host/Kconfig
```kconfig
# SPDX-License-Identifier: (GPL-2.0+ OR MIT)

config AMLOGIC_MMC_MESON_GX
         tristate "Amlogic S905/GX*/AXG SD/MMC Host Controller support"
         depends on MMC
         help
           This selects support for the Amlogic SD/MMC Host Controller
           found on the S905/GX*/AXG family of SoCs.  This controller is
           MMC 5.1 compliant and supports SD, eMMC and SDIO interfaces.
           If you have a controller with this interface, say Y here.

config AMLOGIC_MMC_CQHCI
         tristate "Amlogic MMC CQHCI Host Controller support"
         help
           This selects support for the Amlogic MMC CQHCI Host Controller
           found on the P1/A5/T5M/... family of SoCs.  This controller is
           MMC 5.1 compliant and supports SD, eMMC and SDIO interfaces.
           If you have a controller with this interface, say Y here.

config AMLOGIC_MMC_CRYPTO
	tristate "Amlogic MMC Crypto Engine Support"
	depends on BLK_INLINE_ENCRYPTION && MMC_CRYPTO
	default y
	help
	  Enable Crypto Engine Support in MMC.
	  Enabling this makes it possible for the kernel to use the crypto
	  capabilities of the MMC device (if present) to perform crypto
	  operations on data being transferred to/from the device.

config AMLOGIC_MIN_RESERVED_PARTITION
	tristate "Enable minimal reserved partition format"
	depends on MMC
	default n
	help
	  Enable minimal reserved partition in the MMC.
```

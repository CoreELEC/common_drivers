## drivers/net/phy/Kconfig
```kconfig
# SPDX-License-Identifier: (GPL-2.0+ OR MIT)

config AMLOGIC_INPHY
	tristate "Amlogic Meson GXL Internal PHY"
	help
	  Currently has a driver for the Amlogic Meson GXL Internal PHY

config AMLOGIC_REALTEK
	tristate "Amlogic realtek PHY"
	help
	  Currently has a driver for the Amlogic realtek PHY

config AMLOGIC_MAXIO
	tristate "Amlogic maxio PHY"
	help
	  Currently has a driver for the Amlogic maxio PHY

config AMLOGIC_JLSEMI
	tristate "Amlogic jlsemi PHY"
	help
	  Currently has a driver for the Amlogic jlsemi PHY
```

## drivers/net/pma/Kconfig
```kconfig
# SPDX-License-Identifier: (GPL-2.0+ OR MIT)

config AMLOGIC_HSGMII_PHY
	tristate "Amlogic HSGMII SerDes/PHY driver"
	depends on OF
	depends on HAS_IOMEM
	select GENERIC_PHY
	help
	  Enable this to support the internal SerDes/HSGMII PHY on various
	  Amlogic chipsets.
```

## drivers/pci/Kconfig
```kconfig
# SPDX-License-Identifier: (GPL-2.0+ OR MIT)

menu "Amlogic PCI Support"

config AMLOGIC_PCIE
	tristate "Amlogic PCIE controller support"
	default n
	depends on PCI
	help
	  Amlogic PCIE controller drivers support

source "$(COMMON_DRIVERS_DIR)/drivers/pci/controller/Kconfig"
source "$(COMMON_DRIVERS_DIR)/drivers/pci/phy/Kconfig"

endmenu
```

## drivers/pci/controller/Kconfig
```kconfig
# SPDX-License-Identifier: GPL-2.0-only

config AMLOGIC_PCIE_V2_HOST
	tristate "Meson PCIE_V2 controller"
	depends on AMLOGIC_PCIE
	depends on PCI && PCI_MSI
	depends on PCIE_DW_HOST
	help
	  Say Y here if you want to enable PCIE controller support on Amlogic
	  SoCs. The PCIE controller on Amlogic is based on DesignWare hardware
	  and therefore the driver re-uses the DesignWare core functions to
	  implement the driver.

config AMLOGIC_PCIE_V3_HOST
	tristate "Meson PCIE_V3 controller"
	depends on AMLOGIC_PCIE
	depends on PCI && PCI_MSI
	help
	  Say Y here if you want to enable PCIE controller support on Amlogic
	  SoCs.

config AMLOGIC_PCIE_V3_EP
	tristate "Meson PCIE_V3 endpoint controller"
	depends on PCI
	depends on OF
	depends on AMLOGIC_PCIE
	depends on PCI_ENDPOINT
	depends on PCI_ENDPOINT_CONFIGFS
	depends on PCI_EPF_TEST
	help
	  Say Y or M  here if you want to support Amlogic PCIe controller in
	  endpoint mode on Amlogic SoC.

config AMLOGIC_PCIE_V4_HOST
	tristate "Meson PCIE_V4 controller"
	depends on AMLOGIC_PCIE
	depends on PCI && PCI_MSI
	depends on PCIE_DW_HOST
	help
	  Say Y here if you want to enable PCIE controller support on Amlogic
	  SoCs. The PCIE controller on Amlogic is based on DesignWare hardware
	  and therefore the driver re-uses the DesignWare core functions to
	  implement the driver.
```

## drivers/pci/phy/Kconfig
```kconfig
# SPDX-License-Identifier: GPL-2.0-only

config AMLOGIC_PCIE_PHY_A9
	tristate "Meson PCIE PHY A9"
	depends on AMLOGIC_PCIE
	default n
	help
	  Say Y here if you want to enable PCIE support on Amlogic SoCs.
```

## drivers/pio/Kconfig
```kconfig
# SPDX-License-Identifier: (GPL-2.0-only OR MIT)

config	AMLOGIC_PIO
	tristate "meson pio driver"
	default n
	help
		This option enables support pio setup.
		Enable this option to allow setup pio.
		Say Y if you want to enable PIO function
		or Say N
```

## drivers/power/Kconfig
```kconfig
# SPDX-License-Identifier: (GPL-2.0+ OR MIT)

config AMLOGIC_POWER
	tristate "Amlogic power related driver support"
	default n
	depends on PM_GENERIC_DOMAINS
	help
	  this config enables to use amlogic power management driver
	  Say y here if you want power related driver(pmu/dvfs) support

config AMLOGIC_POWER_EE
	bool "Amlogic power domain ee support"
	default y if (AMLOGIC_POWER=m || AMLOGIC_POWER=y)
	depends on AMLOGIC_POWER
	help
	  this config enables to use amlogic ee power management driver

config AMLOGIC_SM
	tristate "Amlogic Secure Monitor driver"
	default y if (AMLOGIC_POWER=m || AMLOGIC_POWER=y)
	depends on AMLOGIC_POWER
	help
	  Say y here to enable the Amlogic secure monitor driver

source "$(COMMON_DRIVERS_DIR)/drivers/power/meson_pmic6b/Kconfig"
source "$(COMMON_DRIVERS_DIR)/drivers/power/charger/Kconfig"
source "$(COMMON_DRIVERS_DIR)/drivers/power/battery/Kconfig"
```

## drivers/power/battery/Kconfig
```kconfig
# SPDX-License-Identifier: (GPL-2.0+ OR MIT)

if AMLOGIC_POWER

config AMLOGIC_BATTERY_CW2015
	tristate "cw2015 driver"
	depends on I2C
	depends on IIO
	depends on IIO_BUFFER
	depends on IIO_KFIFO_BUF
	depends on AMLOGIC_ADC
	depends on AMLOGIC_MESON_SARADC
	default n
	help
	  Say Y here if you want to use the cw2015 driver.
endif
```

## drivers/power/charger/Kconfig
```kconfig
# SPDX-License-Identifier: (GPL-2.0+ OR MIT)

if AMLOGIC_POWER

config AMLOGIC_CHARGER_SGM415XX
	tristate "sgm415xx charger driver"
	depends on I2C
	depends on IIO
	depends on IIO_BUFFER
	depends on IIO_KFIFO_BUF
	depends on AMLOGIC_ADC
	depends on AMLOGIC_MESON_SARADC
	depends on AMLOGIC_BATTERY_CW2015
	default n
	help
	  Say Y here to enable support for getting battery and charger
	  information and altering charger configurations from the SGM415xx
          charger IC.
endif
```

## drivers/uboot_env/Kconfig
```kconfig
# SPDX-License-Identifier: GPL-2.0-only
# Generic Trusted Execution Environment Configuration
config AMLOGIC_ENV_ENCRYPT
	tristate "Encrypt interface for uboot env"
	depends on HAVE_ARM_SMCCC
	default n
	help
	  This config enables upper layer to encrypt uboot environment. Can
	  help to increase security of uboot env.
```

## drivers/usb/Kconfig
```kconfig
# SPDX-License-Identifier: GPL-2.0

menu "USB Support"

config AMLOGIC_USB
	bool "Amlogic USB controller support"
	default n
	select USB_PHY if AMLOGIC_BREAK_GKI
	depends on USB
	help
	  DWC_OTG
	  USB
	  host
	  controller.

config AMLOGIC_COMMON_USB
	bool "It is used to cover the USB modification for common dir."
	default n
	depends on AMLOGIC_USB
	help
	  DWC_OTG
	  USB
	  host
	  controller.

config AMLOGIC_USB_SUPPORT
	tristate "USB Host controller and phy support"
	depends on AMLOGIC_USB
	help
	  USB Host
	  controller
	  dwc_otg
	  support

config AMLOGIC_USB_DWC_OTG_HCD
	tristate "USB Host controller dwc_otg support"
	depends on AMLOGIC_USB
	help
	  USB Host
	  controller
	  dwc_otg
	  support

config AMLOGIC_CRG
        bool "USB Host controller corigine support"
        depends on AMLOGIC_USB
        help
          USB Host
          controller
          corigine
          support

config MESON_USBPHY
	bool "Meson new USB PHY Driver"
	depends on AMLOGIC_USB
	help
	  Enable this to support new Amlogic USB phy driver for Amlogic SoCs.
	  This driver uses the Generic Phy framework for Amlogic USB 2.0 PHY &
	  Amlogic USB 3.0 PHY and implements Amlogic USB otg functions.

	  For which socs this driver supports, check the files in the driver directory.
if TYPEC

source "$(COMMON_DRIVERS_DIR)/drivers/usb/typec/aw35615/Kconfig"

endif # TYPEC

config AMLOGIC_USBPHY
	bool "Amlogic USB PHY Driver"
	depends on AMLOGIC_USB
	help
	  Enable this to support Amlogic USB phy helper driver for Amlogic SoCs.
	  This driver provides common interface to interact, for Amlogic USB 2.0 PHY
	  driver and later for Amlogic USB 3.0 PHY driver.

	  This driver supports GXBABYTV and G9TV.

          To compile this driver as a module, choose M here: the
          module will be called phy-aml-usb.

config AMLOGIC_USB2PHY
	bool "Amlogic USB 2.0 PHY controller Driver"
	depends on AMLOGIC_USBPHY
	help
	  Enable this to support Amlogic USB 2.0 (High Speed) PHY controller
	  for Amlogic SoCs.

	  This driver supports GXBABYTV and G9TV.

	  To compile this driver as a module, choose M here: the
          module will be called phy-aml-usb.

config AMLOGIC_USB3PHY
	bool "Amlogic USB 3.0 PHY controller Driver"
	depends on AMLOGIC_USBPHY
	help
	  Enable this to support Amlogic USB 3.0 (Super Speed) phy controller
	  for Amlogic SoCs.

	  This driver supports GXBABYTV and G9TV.

          To compile this driver as a module, choose M here: the
          module will be called phy-aml-usb.

config AMLOGIC_USBPHYC2
	bool "Amlogic C2 USB PHY controller Driver"
	depends on AMLOGIC_USBPHY
	help
	  Enable this to support Amlogic USB phy controller
	  for Amlogic SoCs.

	  This driver supports GXBABYTV and G9TV.

	  To compile this driver as a module, choose M here: the
	  module will be called phy-aml-usb.

config AMLOGIC_BC
        bool "Amlogic BC detect Driver"
        depends on AMLOGIC_USB
        help
          Enable this to support Amlogic BC detect for Amlogic SoCs.

          This driver supports C2.

          To compile this driver as a module, choose M here: the
          module will be called amlogic-bc.

config AMLOGIC_CC
        bool "Amlogic CC detect Driver"
        depends on AMLOGIC_USB
        help
          Enable this to support Amlogic CC detect for Amlogic SoCs.

          This driver supports C2.

          To compile this driver as a module, choose M here: the
          module will be called amlogic-cc.

config AMLOGIC_USB_DWC3
	tristate "DesignWare USB3 DRD Core Support"
	depends on AMLOGIC_USB
	depends on AMLOGIC_COMMON_USB
	depends on (USB || USB_GADGET) && HAS_DMA
	depends on (EXTCON || EXTCON=n)
	default y
	select USB_XHCI_PLATFORM if USB_XHCI_HCD
	select USB_ROLE_SWITCH if USB_DWC3_DUAL_ROLE
	help
	  Say Y or M here if your system has a Dual Role SuperSpeed
	  USB controller based on the DesignWare USB3 IP Core.

	  If you choose to build this driver as a dynamically linked
	  module, the module will be called dwc3-meson.ko.

if AMLOGIC_USB_DWC3

config AMLOGIC_USB_DWC3_ULPI
	bool "Register ULPI PHY Interface"
	depends on USB_ULPI_BUS=y || USB_ULPI_BUS=USB_DWC3
	default n
	help
	  Select this if you have ULPI type PHY attached to your DWC3
	  controller.

choice
	bool "DWC3 Mode Selection"
	default AMLOGIC_USB_DWC3_DUAL_ROLE if (USB && USB_GADGET)
	default AMLOGIC_USB_DWC3_HOST if (USB && !USB_GADGET)
	default AMLOGIC_USB_DWC3_GADGET if (!USB && USB_GADGET)

config AMLOGIC_USB_DWC3_HOST
	bool "Host only mode"
	depends on USB=y || USB=USB_DWC3
	help
	  Select this when you want to use DWC3 in host mode only,
	  thereby the gadget feature will be regressed.

config AMLOGIC_USB_DWC3_GADGET
	bool "Gadget only mode"
	depends on USB_GADGET=y || USB_GADGET=USB_DWC3
	help
	  Select this when you want to use DWC3 in gadget mode only,
	  thereby the host feature will be regressed.

config AMLOGIC_USB_DWC3_DUAL_ROLE
	bool "Dual Role mode"
	depends on ((USB=y || USB=USB_DWC3) && (USB_GADGET=y || USB_GADGET=USB_DWC3))
	help
	  This is the default mode of working of DWC3 controller where
	  both host and gadget features are enabled.

endchoice

config AMLOGIC_USB_DWC3_DEBUGFS
	bool "Used to control to build debugfs-meson.c"
	depends on AMLOGIC_USB_DWC3 && DEBUG_FS
	default y
	help
	  Used to control to build debugfs-meson.c.

comment "Platform Glue Driver Support"

config AMLOGIC_USB_DWC3_OTG
	tristate "Amlogic Platforms"
	depends on OF
	default y
	help
	  Some platforms from Amlogic use this IP for USB2/3 functionality.

	  Say 'Y' or 'M' here if you have one such device
endif

endmenu
```

## drivers/usb/typec/aw35615/Kconfig
```kconfig
# SPDX-License-Identifier: (GPL-2.0+ OR MIT)
#
# awinic aw35615 pd controller driver configuration
#

config TYPEC_AW35615
	tristate "Awinic Pd"
	depends on I2C
	help
		this option enables support for the AW35615 PD connected
		through I2C.

		To compile this driver as a module, choose M here: the
		module will be called typec-aw35615.

choice
    prompt "AW35615 Working Mode"
    depends on TYPEC_AW35615
    default TYPEC_AW35615_WHOLE

config TYPEC_AW35615_WHOLE
	bool "Awinic Aw35615 Built-in PD Policy mode"
	help
		This option enables support for the AW35615 PD connected
		through I2C based on vendor-implemented PD protocol stack.

config TYPEC_AW35615_TCPM
	bool "Awinic Aw35615 TCPM mode"
	depends on TYPEC_TCPM
	help
		This option enables support for the AW35615 PD connected
		through I2C based on USB Type-C Port Manager(TCPM).
endchoice
```

## drivers/usb/typec/husb311/Kconfig
```kconfig
# SPDX-License-Identifier: (GPL-2.0+ OR MIT)
#
# awinic aw35615 pd controller driver configuration
#

config  TYPEC_HUSB311
	tristate "HUSB311 Type-C PD"
	depends on I2C
	help
		This option enables support for the HUSB311 Typec-C PD
		connected through I2C.

		To compile this driver as a module, choose M here: the
		module will be called tcpci-husb311.
```

## drivers/usb/typec/mux/Kconfig
```kconfig
# SPDX-License-Identifier: GPL-2.0

config TYPEC_MUX_MESON
	tristate "Amlogic Typec Switch driver"
	depends on REGMAP_MMIO
	help
	  Driver for the Meson Typec Switch, which provides support for muxing
	  USB3 and DP on a common USB Type-C connector.
	  If compiled as a module, the module will be named typec-mux-meson.
```

## drivers/uvm/Kconfig
```kconfig
# SPDX-License-Identifier: (GPL-2.0+ OR MIT)
#
# uvm core configuration
#

config AMLOGIC_UVM
	tristate "UVM support"
	default n
	depends on AMLOGIC_MEDIA_WRAPPER
	help
		Select to enable AMLOGIC UVM driver

config AMLOGIC_UVM_ALLOCATOR
	bool "Amlogic uvm allocator device driver"
	default n
	depends on AMLOGIC_UVM
	help
	  say y to enable amlogic uvm allocator device driver.
	  gralloc will call it to allocate dmabuf fd.

config AMLOGIC_UVM_CORE
	bool "Amlogic unified video memory management"
	default n
	depends on AMLOGIC_UVM_ALLOCATOR
	help
	  say y to enable Amlogic unified video memory management.
	  The uvm core is dmabuf wrap vframe framework.
```

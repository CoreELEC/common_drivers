## arch/arm64/configs/mini_debug_defconfig
```kconfig
#
# USB ADB Support
#
CONFIG_USB=y
CONFIG_USB_SUPPORT=y
CONFIG_USB_OTG=y
CONFIG_USB_XHCI_HCD=y
CONFIG_USB_GADGET=y
CONFIG_USB_CONFIGFS=y
CONFIG_USB_CONFIGFS_UEVENT=y
CONFIG_USB_CONFIGFS_F_FS=y
CONFIG_AMLOGIC_USB=y
CONFIG_AMLOGIC_COMMON_USB=y
CONFIG_AMLOGIC_USB_SUPPORT=m
CONFIG_AMLOGIC_USB_DWC_OTG_HCD=m
CONFIG_AMLOGIC_CRG=y
CONFIG_AMLOGIC_USBPHY=y
CONFIG_AMLOGIC_USB2PHY=y
CONFIG_AMLOGIC_USB3PHY=y
CONFIG_AMLOGIC_USBPHYC2=y

#
# AMLOGIC DEBUG
#
CONFIG_AMLOGIC_DEBUG_ATRACE=y
CONFIG_AMLOGIC_DEBUG_PRINTK=y
CONFIG_AMLOGIC_DEBUG_FILE=y

#
# CLOCK DEBUG
#
CONFIG_AMLOGIC_CLK_DEBUG=y

#
# FTRACE
#
CONFIG_FTRACE=y
CONFIG_STACKTRACE=y

#
# PSTORE
#
CONFIG_PSTORE=y
CONFIG_PSTORE_DEFLATE_COMPRESS=y
CONFIG_PSTORE_COMPRESS=y
CONFIG_PSTORE_DEFLATE_COMPRESS_DEFAULT=y
CONFIG_PSTORE_CONSOLE=y
CONFIG_PSTORE_PMSG=y
CONFIG_PSTORE_FTRACE=y
CONFIG_PSTORE_RAM=y

#
# AMLOGIC RAMDUMP
#
CONFIG_AMLOGIC_RAMDUMP=y

#
# MAGIC SYSRQ
#
CONFIG_MAGIC_SYSRQ=y

#
# PERF
#
CONFIG_PERF_EVENTS=y

#
# DEBUG FS
#
CONFIG_DEBUG_FS=y

#
# BUG ON DATA CORRUPTION
#
CONFIG_BUG_ON_DATA_CORRUPTION=y

#
# KPROBES
#
CONFIG_KPROBES=y

#
# SLUB DEBUG
#
CONFIG_SLUB_DEBUG=y

#
# PM DEBUG
#
CONFIG_PM_DEBUG=y

#
# DEBUG ATOMIC SLEEP
#
CONFIG_DEBUG_ATOMIC_SLEEP=y

#
# DEBUG BUGVERBOSE
#
CONFIG_BUG=y
CONFIG_DEBUG_BUGVERBOSE=y

#
# PRINTK CALLER
#
CONFIG_PRINTK_CALLER=y

#
# DEBUG MISC
#
CONFIG_DEBUG_MISC=y

#
# ANDROID VENDOR HOOKS
#
CONFIG_ANDROID_VENDOR_HOOKS=y

#
# TRACE MMIO ACCESS
#
CONFIG_TRACE_MMIO_ACCESS=y

#
# PROFILING
#
CONFIG_PROFILING=y
```

## arch/arm64/configs/optimize_for_ott.defconfig
```kconfig
# maybe can remove in OTT project
# aml_media.ko feature
CONFIG_AMLOGIC_VOUT3_SERVE=n
CONFIG_AMLOGIC_LCD=n
CONFIG_AMLOGIC_LCD_EXTERN_I2C_OLED=n
CONFIG_AMLOGIC_DisplayPort_TX=n
CONFIG_AMLOGIC_BL_EXTERN=n
CONFIG_AMLOGIC_BL_LDIM=n
CONFIG_AMLOGIC_BL_LDIM_IW7027=n
CONFIG_AMLOGIC_BL_LDIM_BLMCU=n
CONFIG_AMLOGIC_BL_LDIM_ABCON=n
CONFIG_AMLOGIC_AMBILIGHT=n
CONFIG_AMLOGIC_MEDIA_VRR=n
CONFIG_AMLOGIC_POST_PROCESS_MANAGER=n
CONFIG_AMLOGIC_PIC_DEC=n
CONFIG_AMLOGIC_V4L_VIDEO=n
CONFIG_AMLOGIC_VIDEOBUF2_ION=n
CONFIG_AMLOGIC_IONVIDEO=n
CONFIG_AMLOGIC_VIDEOQUEUE=n
CONFIG_AMLOGIC_MEDIA_TVIN_HDMI=n
CONFIG_AMLOGIC_MEDIA_TVIN_DSC_DEC=n
CONFIG_AMLOGIC_MEDIA_TVIN_AFE=n
CONFIG_AMLOGIC_MEDIA_TVIN_VBI=n
CONFIG_AMLOGIC_MEDIA_TVIN_AVDETECT=n
CONFIG_AMLOGIC_MEDIA_TVIN_BT656=n
CONFIG_TYPEC_MUX_MESON=y

# optimize for ott lowram version
CONFIG_ZRAM_WRITEBACK=y
```

## drivers/amfc/aml_erofs/Kconfig
```kconfig
# SPDX-License-Identifier: GPL-2.0-only

config AMLOGIC_EROFS
	tristate "EROFS filesystem support"
	depends on BLOCK
	depends on AMLOGIC_AMFC
	select AMLOGIC_SYM_HELPER
	help
	  EROFS (Enhanced Read-Only File System) is a lightweight read-only
	  file system with modern designs (e.g. no buffer heads, inline
	  xattrs/data, chunk-based deduplication, multiple devices, etc.) for
	  scenarios which need high-performance read-only solutions, e.g.
	  smartphones with Android OS, LiveCDs and high-density hosts with
	  numerous containers;

	  It also provides fixed-sized output compression support in order to
	  improve storage density as well as keep relatively higher compression
	  ratios and implements in-place decompression to reuse the file page
	  for compressed data temporarily with proper strategies, which is
	  quite useful to ensure guaranteed end-to-end runtime decompression
	  performance under extremely memory pressure without extra cost.

	  See the documentation at <file:Documentation/filesystems/erofs.rst>
	  and the web pages at <https://erofs.docs.kernel.org> for more details.

	  If unsure, say N.

config AMLOGIC_EROFS_DEBUG
	bool "EROFS debugging feature"
	depends on AMLOGIC_EROFS
	help
	  Print debugging messages and enable more BUG_ONs which check
	  filesystem consistency and find potential issues aggressively,
	  which can be used for Android eng build, for example.

	  For daily use, say N.

config AMLOGIC_EROFS_XATTR
	bool "EROFS extended attributes"
	depends on AMLOGIC_EROFS
	default y
	help
	  Extended attributes are name:value pairs associated with inodes by
	  the kernel or by users (see the attr(5) manual page, or visit
	  <http://acl.bestbits.at/> for details).

	  If unsure, say N.

config AMLOGIC_EROFS_POSIX_ACL
	bool "EROFS Access Control Lists"
	depends on AMLOGIC_EROFS_XATTR
	default y
	help
	  Posix Access Control Lists (ACLs) support permissions for users and
	  groups beyond the owner/group/world scheme.

	  To learn more about Access Control Lists, visit the POSIX ACLs for
	  Linux website <http://acl.bestbits.at/>.

	  If you don't know what Access Control Lists are, say N.

config AMLOGIC_EROFS_SECURITY
	bool "EROFS Security Labels"
	depends on AMLOGIC_EROFS_XATTR
	default y
	help
	  Security labels provide an access control facility to support Linux
	  Security Models (LSMs) accepted by AppArmor, SELinux, Smack and TOMOYO
	  Linux. This option enables an extended attribute handler for file
	  security labels in the erofs filesystem, so that it requires enabling
	  the extended attribute support in advance.

	  If you are not using a security module, say N.

config AMLOGIC_EROFS_BACKED_BY_FILE
	bool "File-backed EROFS filesystem support"
	depends on AMLOGIC_EROFS
	default y
	help
	  This allows EROFS to use filesystem image files directly, without
	  the intercession of loopback block devices or likewise. It is
	  particularly useful for container images with numerous blobs and
	  other sandboxes, where loop devices behave intricately.  It can also
	  be used to simplify error-prone lifetime management of unnecessary
	  virtual block devices.

	  Note that this feature, along with ongoing fanotify pre-content
	  hooks, will eventually replace "EROFS over fscache."

	  If you don't want to enable this feature, say N.

config AMLOGIC_EROFS_ZIP
	bool "EROFS Data Compression Support"
	depends on AMLOGIC_EROFS
	default y
	help
	  Enable fixed-sized output compression for EROFS.

	  If you don't want to enable compression feature, say N.

config AMLOGIC_EROFS_ZIP_LZMA
	bool "EROFS LZMA compressed data support"
	depends on AMLOGIC_EROFS_ZIP
	help
	  Saying Y here includes support for reading EROFS file systems
	  containing LZMA compressed data, specifically called microLZMA. It
	  gives better compression ratios than the default LZ4 format, at the
	  expense of more CPU overhead.

	  If unsure, say N.

config AMLOGIC_EROFS_ZIP_DEFLATE
	bool "EROFS DEFLATE compressed data support"
	depends on AMLOGIC_EROFS_ZIP
	help
	  Saying Y here includes support for reading EROFS file systems
	  containing DEFLATE compressed data.  It gives better compression
	  ratios than the default LZ4 format, while it costs more CPU
	  overhead.

	  DEFLATE support is an experimental feature for now and so most
	  file systems will be readable without selecting this option.

	  If unsure, say N.

config AMLOGIC_EROFS_ZIP_ZSTD
	bool "EROFS Zstandard compressed data support"
	depends on AMLOGIC_EROFS_ZIP
	help
	  Saying Y here includes support for reading EROFS file systems
	  containing Zstandard compressed data.  It gives better compression
	  ratios than the default LZ4 format, while it costs more CPU
	  overhead.

	  Zstandard support is an experimental feature for now and so most
	  file systems will be readable without selecting this option.

	  If unsure, say N.

config AMLOGIC_EROFS_ONDEMAND
	bool "EROFS fscache-based on-demand read support (deprecated)"
	depends on AMLOGIC_EROFS
	help
	  This permits EROFS to use fscache-backed data blobs with on-demand
	  read support.

	  It is now deprecated and scheduled to be removed from the kernel
	  after fanotify pre-content hooks are landed.

	  If unsure, say N.

config AMLOGIC_EROFS_PCPU_KTHREAD
	bool "EROFS per-cpu decompression kthread workers"
	depends on AMLOGIC_EROFS_ZIP
	help
	  Saying Y here enables per-CPU kthread workers pool to carry out
	  async decompression for low latencies on some architectures.

	  If unsure, say N.

config AMLOGIC_EROFS_PCPU_KTHREAD_HIPRI
	bool "EROFS high priority per-CPU kthread workers"
	depends on AMLOGIC_EROFS_ZIP && AMLOGIC_EROFS_PCPU_KTHREAD
	default y
	help
	  This permits EROFS to configure per-CPU kthread workers to run
	  at higher priority.

	  If unsure, say N.

config AMLOGIC_EROFS_CRYPTO_MAX_PAGES
	int "AMLOGIC EROFS max distance pages for crypto usage"
	default 32
	help
	  This config defines max distance pages for crypto. Crypto layer
	  will use this value to grow up PCP buffers.
	  Default value is 128KB(32 pages).
	  You can change it to your value.
```

## drivers/amfc/aml_zram/Kconfig
```kconfig
# SPDX-License-Identifier: GPL-2.0
config AMLOGIC_ZRAM
	tristate "Compressed RAM block device support"
	depends on BLOCK && SYSFS && MMU
	depends on AMLOGIC_AMFC
	select ZSMALLOC
	help
	  Creates virtual block devices called /dev/zramX (X = 0, 1, ...).
	  Pages written to these disks are compressed and stored in memory
	  itself. These disks allow very fast I/O and compression provides
	  good amounts of memory savings.

	  It has several use cases, for example: /tmp storage, use as swap
	  disks and maybe many more.

	  See Documentation/admin-guide/blockdev/zram.rst for more information.

config AMLOGIC_ZRAM_BACKEND_LZ4
	bool "lz4 compression support"
	depends on AMLOGIC_ZRAM

config AMLOGIC_ZRAM_BACKEND_LZO
	bool "lzo and lzo-rle compression support" 
	depends on AMLOGIC_ZRAM

config AMLOGIC_ZRAM_BACKEND_AMFC
	bool "amfc compression support" 
	depends on AMLOGIC_ZRAM
	depends on AMLOGIC_AMFC

choice
	prompt "Default zram compressor"
	default AMLOGIC_ZRAM_DEF_COMP_LZ4
	depends on AMLOGIC_ZRAM

config AMLOGIC_ZRAM_DEF_COMP_LZO
	bool "lzo"
	depends on AMLOGIC_ZRAM_BACKEND_LZO

config AMLOGIC_ZRAM_DEF_COMP_LZ4
	bool "lz4"
	depends on AMLOGIC_ZRAM_BACKEND_LZ4

config AMLOGIC_ZRAM_DEF_COMP_AMFC
	bool "amfc"
	depends on AMLOGIC_ZRAM_BACKEND_AMFC

endchoice

config AMLOGIC_ZRAM_DEF_COMP
	string
	default "lzo"  if AMLOGIC_ZRAM_DEF_COMP_LZO
	default "lz4"  if AMLOGIC_ZRAM_DEF_COMP_LZ4
	default "amfc" if AMLOGIC_ZRAM_DEF_COMP_AMFC
	default "unset-value"

config AMLOGIC_ZRAM_WRITEBACK
       bool "Write back incompressible or idle page to backing device"
       depends on AMLOGIC_ZRAM
       help
	 This lets zram entries (incompressible or idle pages) be written
	 back to a backing device, helping save memory.
	 For this feature, admin should set up backing device via
	 /sys/block/zramX/backing_dev.

	 With /sys/block/zramX/{idle,writeback}, application could ask
	 idle page's writeback to the backing device to save in memory.

	 See Documentation/admin-guide/blockdev/zram.rst for more information.

config AMLOGIC_ZRAM_TRACK_ENTRY_ACTIME
	bool "Track access time of zram entries"
	depends on AMLOGIC_ZRAM
	help
	  With this feature zram tracks access time of every stored
	  entry (page), which can be used for a more fine grained IDLE
	  pages writeback.

config AMLOGIC_ZRAM_MEMORY_TRACKING
	bool "Track zRam block status"
	depends on AMLOGIC_ZRAM && DEBUG_FS
	select AMLOGIC_ZRAM_TRACK_ENTRY_ACTIME
	help
	  With this feature, admin can track the state of allocated blocks
	  of zRAM. Admin could see the information via
	  /sys/kernel/debug/zram/zramX/block_state.

	  See Documentation/admin-guide/blockdev/zram.rst for more information.

config AMLOGIC_ZRAM_MULTI_COMP
	bool "Enable multiple compression streams"
	depends on AMLOGIC_ZRAM
	help
	  This will enable multi-compression streams, so that ZRAM can
	  re-compress pages using a potentially slower but more effective
	  compression algorithm. Note, that IDLE page recompression
	  requires ZRAM_TRACK_ENTRY_ACTIME.
```

## drivers/char/fw_antirollback/Kconfig
```kconfig
# SPDX-License-Identifier: (GPL-2.0-only OR MIT)

config AMLOGIC_FW_ANTIROLLBACK
	tristate "Amlogic Meson Firmware Anti-rollback support"
	default n
	help
	  This driver provides kernel-side support for the Firmware Anti-rollback
	  checked and updated on Amlogic Meson SoCs.

	  To compile this driver as a module, choose M here. the
	  module will be called meson-fw-antirollback.

	  If unsure, say Y.
```

## drivers/dhp/Kconfig
```kconfig
# SPDX-License-Identifier: (GPL-2.0+ OR MIT)
#
# dhp interface configuration
#

config AMLOGIC_MEDIA_WRAPPER
	tristate "MediaWrapper support"
	default n
	help
	  Select to enable AMLOGIC MediaWrapper
```

## drivers/dma/Kconfig
```kconfig
if DMADEVICES

comment "DMA Devices"

config AMLOGIC_DMA
	tristate "Amlogic general DMA support"
	select DMA_ENGINE
	select DMA_VIRTUAL_CHANNELS
	select REGMAP_MMIO
	help
          Enable support for the Amlogic general DMA engines. THis DMA
          controller is used some Amlogic SoCs, such as A9.
endif
```

## drivers/dvb/smartcard_sc2/Kconfig
```kconfig
# SPDX-License-Identifier: (GPL-2.0+ OR MIT)
#
#Smart card driver configuration
#

config AMLOGIC_SMARTCARD
	tristate "Amlogic Smartcard sc2 driver"
	default n
```

## drivers/external/Kconfig
```kconfig
#
# external drivers configuration
#
menu "external Device Drivers"

config AMLOGIC_EXTERNAL_DRIVER
       tristate "amlogic external device support"
       default n
       help
         Say Y here if you want to use external device.

if AMLOGIC_EXTERNAL_DRIVER
source "$(COMMON_DRIVERS_DIR)/drivers/external/leds/Kconfig"
source "$(COMMON_DRIVERS_DIR)/drivers/external/nfc/nta533/Kconfig"
source "$(COMMON_DRIVERS_DIR)/drivers/external/sensor/htu20d/Kconfig"
source "$(COMMON_DRIVERS_DIR)/drivers/external/sensor/radar/Kconfig"
source "$(COMMON_DRIVERS_DIR)/drivers/external/sensor/ucs11681/Kconfig"
source "$(COMMON_DRIVERS_DIR)/drivers/external/sensor/ucs116e0/Kconfig"
source "$(COMMON_DRIVERS_DIR)/drivers/external/video/st7789v3_tft/Kconfig"
source "$(COMMON_DRIVERS_DIR)/drivers/external/MG24_ota_gpio_ctrl/Kconfig"
source "$(COMMON_DRIVERS_DIR)/drivers/external/hdmirx_switch/Kconfig"
endif

endmenu
```

## drivers/external/MG24_ota_gpio_ctrl/Kconfig
```kconfig
#
# gpio read drivers configuration
#

config SEI_GPIO_CTRL
	tristate "SEI gpio crtl device support"
	default n
	help
	  Say Y here if you want to use the gpio crtl.
```

## drivers/external/hdmirx_switch/Kconfig
```kconfig
# SPDX-License-Identifier: (GPL-2.0+ OR MIT)

config  HDMIRX_SWITCH_GSV2715
	tristate "i2c gsv2715 driver"
	default n
```

## drivers/external/leds/Kconfig
```kconfig
# SPDX-License-Identifier: GPL-2.0-only
#
# RTC class/drivers configuration
#

config LEDS_AW21036
	tristate "Support for AW21036 led"
	depends on I2C && LEDS_CLASS
	default n
	help
		Say Y here if you want to use the AW21036 LED depends on I2C && LEDS_CLASS.
```

## drivers/external/sensor/inf_bgt60/Kconfig
```kconfig
config SEI_INF_BGT60
	tristate "SEI Infineon BGT60CUTR13AIP Radar Sensor support"
	depends on I2C
	default n
	help
		Say Y here if you want to use the NTA533 depends on I2C
```

## drivers/external/sensor/ucs11681/Kconfig
```kconfig
config SEI_UCS11681_LIGHT
	tristate "Support for light sensor function"
	depends on I2C && LEDS_CLASS
	default m
	help
		Say Y here if you want to use the light sensor depends on I2C && LEDS_CLASS.
```

## drivers/external/sensor/ucs116e0/Kconfig
```kconfig
config SEI_UCS116E0_LIGHT
	tristate "Support for light sensor function"
	depends on I2C && LEDS_CLASS
	default n
	help
		Say Y here if you want to use the light sensor depends on I2C && LEDS_CLASS.
```

## drivers/external/touch/gt9xx/Kconfig
```kconfig
#
# Goodix GT9xx Touchscreen driver
#
config TOUCHSCREEN_GT9XX
	tristate "Goodix touchpanel GT9xx series"
	depends on I2C
	default n
```

## drivers/fs/Kconfig
```kconfig
menu "Meson filesystem modification for common code"

config AMLOGIC_INCFS_FIX
	bool "skip incfs invalid data which is pos > size"
	depends on INCREMENTAL_FS
	default n
	help
	  skip incfs invalid data which is pos > size.

config AMLOGIC_EXT4_FIX
	bool "EXT4 i_state_flags issue fix"
	depends on EXT4_FS
	default n
	help
	  EXT4 i_state_flags issue fix.
endmenu
```

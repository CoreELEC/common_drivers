## arch/arm/configs/meson64_a32_C4_mini_defconfig
```kconfig
# CONFIG_LOCALVERSION_AUTO is not set
CONFIG_SYSVIPC=y
CONFIG_NO_HZ=y
CONFIG_HIGH_RES_TIMERS=y
CONFIG_PREEMPT=y
CONFIG_BLK_DEV_INITRD=y
# CONFIG_RD_BZIP2 is not set
# CONFIG_RD_LZMA is not set
# CONFIG_RD_XZ is not set
# CONFIG_RD_LZO is not set
# CONFIG_RD_LZ4 is not set
# CONFIG_RD_ZSTD is not set
CONFIG_EXPERT=y
# CONFIG_BUG is not set
CONFIG_AMLOGIC_LINUX_S_OPTIMIZE=y
CONFIG_ARCH_VIRT=y
CONFIG_ARM_THUMBEE=y
# CONFIG_KUSER_HELPERS is not set
# CONFIG_VDSO is not set
# CONFIG_CACHE_L2X0 is not set
# CONFIG_ARM_ERRATA_643719 is not set
CONFIG_SMP=y
# CONFIG_SMP_ON_UP is not set
CONFIG_NR_CPUS=2
CONFIG_HOTPLUG_CPU=y
CONFIG_HZ_250=y
CONFIG_THUMB2_KERNEL=y
CONFIG_HIGHMEM=y
# CONFIG_ARM_MODULE_PLTS is not set
# CONFIG_ATAGS is not set
CONFIG_CPU_FREQ=y
CONFIG_CPU_FREQ_STAT=y
CONFIG_CPU_IDLE=y
CONFIG_ARM_CPUIDLE=y
CONFIG_ARM_PSCI_CPUIDLE=y
CONFIG_VFP=y
CONFIG_NEON=y
# CONFIG_SUSPEND is not set
CONFIG_PM=y
# CONFIG_SECCOMP is not set
# CONFIG_STACKPROTECTOR is not set
# CONFIG_VMAP_STACK is not set
# CONFIG_STRICT_KERNEL_RWX is not set
CONFIG_MODULES=y
CONFIG_MODULE_UNLOAD=y
CONFIG_PARTITION_ADVANCED=y
# CONFIG_MSDOS_PARTITION is not set
# CONFIG_MQ_IOSCHED_KYBER is not set
CONFIG_GKI_HIDDEN_REGMAP_CONFIGS=y
# CONFIG_COMPAT_BRK is not set
CONFIG_DEFAULT_MMAP_MIN_ADDR=32768
CONFIG_CMA=y
CONFIG_NET=y
CONFIG_PACKET=y
CONFIG_UNIX=y
CONFIG_INET=y
CONFIG_IP_PNP=y
CONFIG_IP_PNP_DHCP=y
# CONFIG_IPV6 is not set
CONFIG_RFKILL=m
# CONFIG_ETHTOOL_NETLINK is not set
CONFIG_DEVTMPFS=y
CONFIG_DEVTMPFS_MOUNT=y
# CONFIG_ALLOW_DEV_COREDUMP is not set
CONFIG_ARM_SCMI_PROTOCOL=y
CONFIG_MTD=y
CONFIG_MTD_CMDLINE_PARTS=y
CONFIG_MTD_BLOCK=m
CONFIG_MTD_RAW_NAND=m
CONFIG_MTD_UBI=m
CONFIG_BLK_DEV_RAM=y
CONFIG_BLK_DEV_RAM_COUNT=1
CONFIG_NETDEVICES=y
# CONFIG_NET_CORE is not set
# CONFIG_ETHERNET is not set
# CONFIG_WLAN is not set
# CONFIG_INPUT is not set
# CONFIG_SERIO is not set
# CONFIG_VT is not set
# CONFIG_LEGACY_PTYS is not set
CONFIG_SERIAL_DEV_BUS=y
CONFIG_HW_RANDOM=y
# CONFIG_DEVMEM is not set
# CONFIG_DEVPORT is not set
CONFIG_I2C=m
CONFIG_I2C_CHARDEV=m
CONFIG_I2C_MUX=m
CONFIG_SPI=y
CONFIG_PINCTRL=y
CONFIG_PINCTRL_SINGLE=y
CONFIG_GPIOLIB=y
CONFIG_GPIOLIB_FASTPATH_LIMIT=128
CONFIG_GPIO_SYSFS=y
CONFIG_POWER_RESET=y
CONFIG_POWER_SUPPLY=y
# CONFIG_HWMON is not set
CONFIG_THERMAL=y
CONFIG_THERMAL_EMERGENCY_POWEROFF_DELAY_MS=200
CONFIG_CPU_THERMAL=y
CONFIG_WATCHDOG=y
CONFIG_WATCHDOG_CORE=y
CONFIG_MFD_SYSCON=y
CONFIG_REGULATOR=y
CONFIG_REGULATOR_FIXED_VOLTAGE=y
CONFIG_REGULATOR_GPIO=y
CONFIG_REGULATOR_VCTRL=y
CONFIG_FB=m
# CONFIG_USB_SUPPORT is not set
CONFIG_MMC=m
# CONFIG_PWRSEQ_EMMC is not set
CONFIG_MMC_BLOCK_MINORS=16
CONFIG_RTC_CLASS=y
# CONFIG_RTC_NVMEM is not set
CONFIG_DMADEVICES=y
CONFIG_SYNC_FILE=y
CONFIG_DMABUF_HEAPS=y
CONFIG_DMABUF_SYSFS_STATS=y
CONFIG_DMABUF_HEAPS_SYSTEM=m
# CONFIG_VIRTIO_MENU is not set
# CONFIG_VHOST_MENU is not set
CONFIG_COMMON_CLK_SCMI=y
# CONFIG_IOMMU_SUPPORT is not set
CONFIG_PM_DEVFREQ=y
CONFIG_DEVFREQ_GOV_SIMPLE_ONDEMAND=y
CONFIG_PWM=y
CONFIG_RESET_CONTROLLER=y
# CONFIG_NVMEM is not set
# CONFIG_DNOTIFY is not set
CONFIG_MSDOS_FS=m
CONFIG_VFAT_FS=m
CONFIG_NTFS3_FS=m
CONFIG_TMPFS=y
CONFIG_TMPFS_POSIX_ACL=y
CONFIG_UBIFS_FS=m
CONFIG_UBIFS_FS_ADVANCED_COMPR=y
# CONFIG_UBIFS_FS_ZLIB is not set
# CONFIG_NETWORK_FILESYSTEMS is not set
CONFIG_NLS=y
CONFIG_NLS_CODEPAGE_437=m
CONFIG_NLS_ISO8859_1=m
CONFIG_KEYS=y
CONFIG_CRYPTO_AES=m
CONFIG_CRYPTO_DES=m
CONFIG_CRYPTO_SHA256=m
CONFIG_CRYPTO_USER_API_SKCIPHER=m
# CONFIG_CRYPTO_HW is not set
CONFIG_ASYMMETRIC_KEY_TYPE=y
CONFIG_ASYMMETRIC_PUBLIC_KEY_SUBTYPE=m
CONFIG_DMA_CMA=y
CONFIG_CMA_SIZE_MBYTES=8
CONFIG_CMA_ALIGNMENT=4
CONFIG_PRINTK_TIME=y
# CONFIG_DEBUG_MISC is not set
CONFIG_DEBUG_INFO_DWARF_TOOLCHAIN_DEFAULT=y
CONFIG_FRAME_WARN=2048
CONFIG_DEBUG_SECTION_MISMATCH=y
# CONFIG_SECTION_MISMATCH_WARN_ONLY is not set
# CONFIG_SLUB_DEBUG is not set
CONFIG_PANIC_ON_OOPS=y
CONFIG_PANIC_TIMEOUT=5
CONFIG_SOFTLOCKUP_DETECTOR=y
CONFIG_BOOTPARAM_SOFTLOCKUP_PANIC=y
CONFIG_STACKTRACE=y
# CONFIG_RCU_TRACE is not set
# CONFIG_FTRACE is not set
# CONFIG_RUNTIME_TESTING_MENU is not set
CONFIG_AMLOGIC_DRIVER=y
CONFIG_AMLOGIC_BREAK_GKI=y
CONFIG_AMLOGIC_MODIFY=y
CONFIG_AMLOGIC_IN_KERNEL_MODULES=y
CONFIG_AMLOGIC_AMFC=y
CONFIG_AMLOGIC_SERIAL_MESON=y
CONFIG_AMLOGIC_SERIAL_EARLY_CONSOLE=y
CONFIG_AMLOGIC_SERIAL_MESON_CONSOLE=y
CONFIG_AMLOGIC_COMMON_CLK=y
CONFIG_AMLOGIC_COMMON_CLK_MESON_REGMAP=y
CONFIG_AMLOGIC_COMMON_CLK_MESON_DUALDIV=y
CONFIG_AMLOGIC_COMMON_CLK_MESON_PLL=y
CONFIG_AMLOGIC_COMMON_CLK_MESON_CLKC_UTILS=y
CONFIG_AMLOGIC_COMMON_CLK_MESON_CPU_DYNDIV=y
CONFIG_AMLOGIC_MESON_CLK_MEASURE=y
CONFIG_AMLOGIC_BYPASS_CCF_CLK=y
CONFIG_AMLOGIC_COMMON_CLK_C4=y
CONFIG_AMLOGIC_SECMON=y
CONFIG_AMLOGIC_MEDIA_MODULE=m
CONFIG_AMLOGIC_MEDIA_ENABLE=y
CONFIG_AMLOGIC_MEDIA_COMMON=y
CONFIG_AMLOGIC_MEDIA_DRIVERS=y
CONFIG_AMLOGIC_MEDIA_CANVAS=y
CONFIG_AMLOGIC_MEDIA_GE2D=y
CONFIG_AMLOGIC_ION_DEV=y
CONFIG_AMLOGIC_ION=y
CONFIG_AMLOGIC_ION_SYSTEM_HEAP=y
CONFIG_AMLOGIC_VPU=y
CONFIG_AMLOGIC_MEDIA_RDMA=y
CONFIG_AMLOGIC_MEDIA_VSYNC_RDMA=y
CONFIG_AMLOGIC_MEDIA_VFM=y
CONFIG_AMLOGIC_MEDIA_CODEC_MM=y
CONFIG_AMLOGIC_MEDIA_SW_SYNC=y
CONFIG_AMLOGIC_VOUT=y
CONFIG_AMLOGIC_VOUT_CLK_SERVE=y
CONFIG_AMLOGIC_VOUT_SERVE=y
CONFIG_AMLOGIC_LCD=y
CONFIG_AMLOGIC_LCD_MIPI_DSI=y
CONFIG_AMLOGIC_LCD_EXTERN=y
CONFIG_AMLOGIC_MEDIA_VIDEO=y
CONFIG_AMLOGIC_MEDIA_FB=y
CONFIG_AMLOGIC_MEDIA_FB_OSD_VSYNC_RDMA=y
CONFIG_AMLOGIC_MEDIA_FB_OSD2_ENABLE=y
CONFIG_AMLOGIC_MEDIA_FB_OSD2_CURSOR=y
CONFIG_AMLOGIC_MEDIA_VIDEO_PROCESSOR=y
CONFIG_AMLOGIC_VIDEO_COMPOSER=y
# CONFIG_AMLOGIC_MEDIA_V2D is not set
CONFIG_AMLOGIC_MEDIA_GDC=y
CONFIG_AMLOGIC_POWER=m
CONFIG_AMLOGIC_CPU_INFO=y
CONFIG_AMLOGIC_SHOW_CPU_CHIPID=y
CONFIG_AMLOGIC_PM=m
CONFIG_AMLOGIC_GX_REBOOT=m
CONFIG_AMLOGIC_GPIO=m
CONFIG_AMLOGIC_GPIOLIB=y
CONFIG_AMLOGIC_MESON_IRQ_GPIO=y
CONFIG_AMLOGIC_PINCTRL_MESON=y
CONFIG_AMLOGIC_PINCTRL_MESON_C3=m
CONFIG_AMLOGIC_PINCTRL_MESON_C4=m
CONFIG_AMLOGIC_I2C=m
CONFIG_AMLOGIC_I2C_MESON=y
CONFIG_AMLOGIC_I2C_MESON_V2=y
CONFIG_AMLOGIC_SPI=m
CONFIG_AMLOGIC_SPI_MESON_SPICC=m
CONFIG_AMLOGIC_SPI_MESON_SPIFC_V2=m
CONFIG_AMLOGIC_SPI_NFC=y
CONFIG_AMLOGIC_GKI_TOOL=y
CONFIG_AMLOGIC_PWM=m
CONFIG_AMLOGIC_PWM_MESON=y
CONFIG_AMLOGIC_PWM_MESON_TEE=y
CONFIG_AMLOGIC_MESON_CPUFREQ=m
CONFIG_AMLOGIC_EFUSE_UNIFYKEY=m
CONFIG_AMLOGIC_EFUSE=y
CONFIG_AMLOGIC_UNIFYKEY=y
CONFIG_AMLOGIC_EFUSE_BURN=y
CONFIG_AMLOGIC_ARM_SMC_WATCHDOG=m
CONFIG_AMLOGIC_MEMORY_EXTEND=y
CONFIG_AMLOGIC_MEM_DEBUG=y
CONFIG_AMLOGIC_STACKPROTECTOR=y
CONFIG_AMLOGIC_MEMORY_OPT=y
CONFIG_AMLOGIC_DTB_NODE_OPT=y
CONFIG_AMLOGIC_KALLSYM_OPT=y
CONFIG_AMLOGIC_MEMORY_SLAB_LARGE=y
CONFIG_AMLOGIC_MEMORY_DEBUG=y
CONFIG_AMLOGIC_REG_ACCESS=y
CONFIG_AMLOGIC_HW_RANDOM_MESON=m
CONFIG_AMLOGIC_RESET_MESON=m
CONFIG_AMLOGIC_RTC=m
CONFIG_AMLOGIC_MESON_RTC=y
CONFIG_AMLOGIC_AMLOGIC_THERMAL=m
CONFIG_AMLOGIC_COOLDEV=y
CONFIG_AMLOGIC_DDR_THERMAL=y
CONFIG_AMLOGIC_CPUCORE_THERMAL=y
CONFIG_AMLOGIC_MMC_MESON_GX=m
CONFIG_AMLOGIC_DEBUG=y
CONFIG_AMLOGIC_BGKI_DEBUG_MISC=y
CONFIG_AMLOGIC_BOOT_TIME=y
CONFIG_AMLOGIC_DEBUG_HLD=y
CONFIG_AMLOGIC_ENV_DEBUG=y
CONFIG_AMLOGIC_ARMV8_AARCH32=y
CONFIG_AMLOGIC_DEBUG_ISOLCPUS=y
CONFIG_AMLOGIC_AUTO_CAPTURE=y
CONFIG_AMLOGIC_CRYPTO_DMA=m
CONFIG_AMLOGIC_WIRELESS=m
CONFIG_AMLOGIC_WIFI=y
CONFIG_AMLOGIC_PWM_32K=y
CONFIG_AMLOGIC_MTD_SPI_NAND=m
CONFIG_AMLOGIC_MTD_NAND=m
CONFIG_AMLOGIC_MTD_SPI_NOR=m
CONFIG_AMLOGIC_REGULATOR=m
CONFIG_AMLOGIC_REGULATOR_PWM=y
CONFIG_AMLOGIC_REGULATOR_PWM_MODIFY=y
```

## arch/arm/configs/optimize_for_tv.defconfig
```kconfig
# maybe can remove in TV project
# aml_media.ko
CONFIG_AMLOGIC_VOUT3_SERVE=n
CONFIG_AMLOGIC_HDMITX=n
CONFIG_AMLOGIC_HDMITX21=n
CONFIG_AMLOGIC_DSC=n
CONFIG_AMLOGIC_BL_EXTERN=n
CONFIG_AMLOGIC_CVBS_OUTPUT=n
CONFIG_AMLOGIC_WSS=n
CONFIG_AMLOGIC_PIC_DEC=n
CONFIG_AMLOGIC_V4L_VIDEO=n
CONFIG_AMLOGIC_VIDEOBUF2_ION=n
CONFIG_AMLOGIC_IONVIDEO=n
CONFIG_AMLOGIC_MEDIA_TVIN_BT656=n
CONFIG_AMLOGIC_MEDIA_CAMERA=n
CONFIG_AMLOGIC_DRM_HDMI=n
CONFIG_AMLOGIC_DRM_CUT_HDMI=y
CONFIG_AMLOGIC_DRM_CUT_HDMI_MODERN=y
CONFIG_AMLOGIC_DRM_CUT_CVBS=y
CONFIG_AMLOGIC_DPTX=n
CONFIG_AMLOGIC_MEDIA_FRAME_SYN=n
CONFIG_AMLOGIC_MEDIA_TVIN_CSI=n
CONFIG_AMLOGIC_TVIN_USE_DEBUG_FILE=n
CONFIG_AMLOGIC_MEDIA_MSYNC=n
CONFIG_AMLOGIC_DI_V4L=n

# amlogic-snd-codec-t9015.ko
CONFIG_AMLOGIC_SND_CODEC_AMLT9015=n
```

## arch/arm64/configs/amlogic_car.defconfig
```kconfig
CONFIG_AMLOGIC_BREAK_GKI=y
CONFIG_AMLOGIC_FREERTOS=y
CONFIG_AMLOGIC_FREERTOS_T7=y
CONFIG_AMLOGIC_ENV_DEBUG=y
```

## arch/arm64/configs/amlogic_kasan.defconfig
```kconfig
# arm64 need set lto=none

CONFIG_KASAN_GENERIC=y
CONFIG_FORTIFY_SOURCE=n
CONFIG_SECTION_MISMATCH_WARN_ONLY=y
CONFIG_RANDOMIZE_BASE=n
CONFIG_KASAN_OUTLINE=n
CONFIG_SHADOW_CALL_STACK=n
CONFIG_KVM=n
CONFIG_KALLSYMS_ALL=n
```

## arch/arm64/configs/amlogic_upgrade.defconfig
```kconfig
# SPDX-License-Identifier: (GPL-2.0+ OR MIT)

# amlogic-gkitool.ko
CONFIG_AMLOGIC_GKI_TOOL=y
CONFIG_AMLOGIC_CLASS_DEBUG=y

# amlogic-debug-iotrace.ko
CONFIG_AMLOGIC_DEBUG_IOTRACE=y
CONFIG_AMLOGIC_DEBUG_IOTM=y

# amlogic-uart.ko
CONFIG_AMLOGIC_SERIAL_MESON=y
CONFIG_AMLOGIC_SERIAL_MESON_CONSOLE=y

# amlogic-hwspinlock.ko
CONFIG_AMLOGIC_HWSPINLOCK=y

# amlogic-debug.ko
CONFIG_AMLOGIC_DEBUG=y
CONFIG_AMLOGIC_DEBUG_HLD=y
CONFIG_AMLOGIC_DEBUG_ATRACE=y
CONFIG_AMLOGIC_DEBUG_TEST=n
CONFIG_AMLOGIC_DEBUG_FILE=n
CONFIG_AMLOGIC_GKI_CONFIG=y
CONFIG_AMLOGIC_UBOOT_LOG=y
CONFIG_AMLOGIC_DEBUG_PRINTK=y

# amlogic-secmon.ko
CONFIG_AMLOGIC_SECMON=y
CONFIG_AMLOGIC_DOLBY_FW=y

# user_fault.ko
CONFIG_AMLOGIC_USER_FAULT=y

# amlogic-memory-debug.ko
CONFIG_AMLOGIC_MEMORY_DEBUG=y

# clk-scmi.ko
CONFIG_COMMON_CLK_SCMI=y

# amlogic-clk.ko
CONFIG_AMLOGIC_COMMON_CLK=y
CONFIG_AMLOGIC_COMMON_CLK_MESON_AO_CLKC=y
CONFIG_AMLOGIC_COMMON_CLK_MESON_CPU_DYNDIV=y
CONFIG_AMLOGIC_COMMON_CLK_MESON_DUALDIV=y
CONFIG_AMLOGIC_COMMON_CLK_MESON_EE_CLKC=y
CONFIG_AMLOGIC_COMMON_CLK_MESON_MPLL=y
CONFIG_AMLOGIC_COMMON_CLK_MESON_PHASE=y
CONFIG_AMLOGIC_COMMON_CLK_MESON_PLL=y
CONFIG_AMLOGIC_COMMON_CLK_MESON_REGMAP=y
CONFIG_AMLOGIC_COMMON_CLK_MESON_SCLK_DIV=y
CONFIG_AMLOGIC_COMMON_CLK_MESON_VID_PLL_DIV=y
CONFIG_AMLOGIC_COMMON_CLK_MESON_CLKC_UTILS=y
CONFIG_AMLOGIC_MESON_CLK_MEASURE=y
CONFIG_AMLOGIC_CLK_DEBUG=y

# amlogic-clk-v2.ko
CONFIG_AMLOGIC_COMMON_CLK_V2=y

# amlogic-clk-soc-s4.ko
CONFIG_AMLOGIC_COMMON_CLK_S4=y

# amlogic-clk-soc-sc2.ko
CONFIG_AMLOGIC_COMMON_CLK_SC2=y

# amlogic-clk-soc-t3.ko
CONFIG_AMLOGIC_COMMON_CLK_T3=y

# amlogic-clk-soc-t7.ko
CONFIG_AMLOGIC_COMMON_CLK_T7=y

# amlogic-clk-soc-t5m.ko
CONFIG_AMLOGIC_COMMON_CLK_T5M=y

# amlogic-clk-soc-g12a.ko
CONFIG_AMLOGIC_COMMON_CLK_G12A=y

# amlogic-clk-soc-s5.ko
CONFIG_AMLOGIC_COMMON_CLK_S5=y

# amlogic-clk-soc-t5w.ko
CONFIG_AMLOGIC_COMMON_CLK_T5W=y

# amlogic-clk-soc-t6d.ko
CONFIG_AMLOGIC_COMMON_CLK_T6D=y

# amlogic-clk-soc-t6w.ko
CONFIG_AMLOGIC_COMMON_CLK_T6W=y

# amlogic-clk-soc-t6x.ko
CONFIG_AMLOGIC_COMMON_CLK_T6X=y

# amlogic-clk-soc-s7.ko
CONFIG_AMLOGIC_COMMON_CLK_S7=y

# amlogic-clk-soc-s6.ko
CONFIG_AMLOGIC_COMMON_CLK_S6=y

# amlogic-clk-soc-t3x.ko
CONFIG_AMLOGIC_COMMON_CLK_T3X=y

# amlogic-clk-soc-s7d.ko
CONFIG_AMLOGIC_COMMON_CLK_S7D=y

# amlogic-clk-soc-a9.ko
CONFIG_AMLOGIC_COMMON_CLK_A9=y

# amlogic-env.ko
CONFIG_AMLOGIC_ENV_ENCRYPT=y

# amlogic-gpio.ko
CONFIG_AMLOGIC_GPIO=y
CONFIG_AMLOGIC_GPIOLIB=y
CONFIG_AMLOGIC_GPIOLIB_SYSFS=y
CONFIG_AMLOGIC_GPIO_DEBUG=y
CONFIG_AMLOGIC_MESON_IRQ_GPIO=y
CONFIG_AMLOGIC_PINCTRL_MESON=y

# amlogic-pinctrl-soc-s4.ko
CONFIG_AMLOGIC_PINCTRL_MESON_S4=y

# amlogic-pinctrl-soc-sc2.ko
CONFIG_AMLOGIC_PINCTRL_MESON_SC2=y

# amlogic-pinctrl-soc-t3.ko
CONFIG_AMLOGIC_PINCTRL_MESON_T3=y

# amlogic-pinctrl-soc-t7.ko
CONFIG_AMLOGIC_PINCTRL_MESON_T7=y

# amlogic-pinctrl-soc-t5m.ko
CONFIG_AMLOGIC_PINCTRL_MESON_T5M=y

# amlogic-pinctrl-soc-g12a.ko
CONFIG_AMLOGIC_PINCTRL_MESON_G12A=y

# amlogic-pinctrl-soc-s5.ko
CONFIG_AMLOGIC_PINCTRL_MESON_S5=y

# amlogic-pinctrl-soc-t5w.ko
CONFIG_AMLOGIC_PINCTRL_MESON_T5W=y

# amlogic-pinctrl-soc-t3x.ko
CONFIG_AMLOGIC_PINCTRL_MESON_T3X=y

# amlogic-pinctrl-soc-tm2.ko
CONFIG_AMLOGIC_PINCTRL_MESON_TM2=y

# amlogic-pinctrl-soc-s7.k
CONFIG_AMLOGIC_PINCTRL_MESON_S7=y

# amlogic-pinctrl-soc-s7d.ko
CONFIG_AMLOGIC_PINCTRL_MESON_S7D=y

# amlogic-pinctrl-soc-s6.ko
CONFIG_AMLOGIC_PINCTRL_MESON_S6=y

# amlogic-pinctrl-soc-t6d.ko
CONFIG_AMLOGIC_PINCTRL_MESON_T6D=y

# amlogic-pinctrl-soc-t6w.ko
CONFIG_AMLOGIC_PINCTRL_MESON_T6W=y

# amlogic-pinctrl-soc-t6x.ko
CONFIG_AMLOGIC_PINCTRL_MESON_T6X=y

# amlogic-pinctrl-soc-a9.ko
CONFIG_AMLOGIC_PINCTRL_MESON_A9=y

# amlogic-pinctrl-a4.ko
CONFIG_AMLOGIC_PINCTRL_A4=y

# amlogic-mailbox.ko
CONFIG_AMLOGIC_MHU_MBOX=y

# amlogic-pwm.ko
CONFIG_AMLOGIC_PWM=y
CONFIG_AMLOGIC_PWM_MESON=y
CONFIG_AMLOGIC_PWM_MESON_TEE=y

# amlogic-regulator.ko
CONFIG_AMLOGIC_REGULATOR=y
CONFIG_AMLOGIC_REGULATOR_PWM=y
CONFIG_AMLOGIC_REGULATOR_PWM_MODIFY=y

# amlogic-reset.ko
CONFIG_AMLOGIC_RESET_MESON=y
CONFIG_AMLOGIC_DOS_RESET_MESON=y

# amlogic-power.ko
CONFIG_AMLOGIC_POWER=y

# amlogic-cpuinfo.ko
CONFIG_AMLOGIC_CPU_INFO=y
CONFIG_AMLOGIC_SHOW_CPU_CHIPID=y

# amlogic-cpufreq.ko
CONFIG_AMLOGIC_MESON_CPUFREQ=y

# amlogic-thermal.ko
CONFIG_AMLOGIC_AMLOGIC_THERMAL=y
CONFIG_AMLOGIC_COOLDEV=y
CONFIG_AMLOGIC_GPU_THERMAL=y
CONFIG_AMLOGIC_DDR_THERMAL=y

# amlogic-mmc.ko
CONFIG_AMLOGIC_MMC_MESON_GX=y
CONFIG_AMLOGIC_MMC_CQHCI=y
CONFIG_AMLOGIC_MMC_CRYPTO=y

# amlogic-efuse-unifykey.ko
CONFIG_AMLOGIC_EFUSE_UNIFYKEY=y
CONFIG_AMLOGIC_EFUSE=y
CONFIG_AMLOGIC_EFUSE_BURN=y
CONFIG_AMLOGIC_UNIFYKEY=y
CONFIG_AMLOGIC_DEFENDKEY=y

# amlogic-i2c.ko
CONFIG_AMLOGIC_I2C=y
CONFIG_AMLOGIC_I2C_MESON=y
CONFIG_AMLOGIC_I2C_MESON_T6W=y
CONFIG_AMLOGIC_I2C_MESON_V2=y
CONFIG_I2C_CHARDEV=m

# amlogic-spi.ko
CONFIG_AMLOGIC_SPI=y
CONFIG_AMLOGIC_SPI_MESON_SPICC=y
CONFIG_AMLOGIC_SPI_MESON_SPICC_V2=y
CONFIG_AMLOGIC_SPI_MESON_SPIFC=y
CONFIG_AMLOGIC_SPI_MESON_SPICC_SLAVE=y

# amlogic-rng.ko
CONFIG_AMLOGIC_HW_RANDOM_MESON=y

# tee.ko
CONFIG_AMLOGIC_AMLTEE=y

# optee.ko
CONFIG_AMLOGIC_OPTEE=y

# amlogic-tee.ko
CONFIG_AMLOGIC_TEE=y

# aml_smmu.ko
CONFIG_AMLOGIC_FAKE_SMMU=y

# slab_large.ko
CONFIG_AMLOGIC_MEMORY_SLAB_LARGE=y

# dvb-core.ko
CONFIG_AMLOGIC_DVB_CORE=y

# amlogic-pm.ko
CONFIG_AMLOGIC_PM=y
CONFIG_AMLOGIC_GX_SUSPEND=y
CONFIG_AMLOGIC_LEGACY_EARLY_SUSPEND=y
CONFIG_AMLOGIC_GX_REBOOT=y

# amlogic-adc.ko
CONFIG_AMLOGIC_ADC=y
CONFIG_AMLOGIC_MESON_SARADC=y
CONFIG_AMLOGIC_SARADC_COMMON=y
CONFIG_AMLOGIC_SARADC=y
CONFIG_AMLOGIC_PDD=y

# amlogic-input.ko
CONFIG_AMLOGIC_INPUT=y
CONFIG_AMLOGIC_GPIO_KEY=y
CONFIG_AMLOGIC_ADC_KEYPADS=y
CONFIG_AMLOGIC_MESON_IR=y
CONFIG_AMLOGIC_INPUT_FILTER=y

# amlogic-watchdog.ko
CONFIG_AMLOGIC_MESON_GXBB_WATCHDOG=y

# amlogic-snd-vad.ko
CONFIG_AMLOGIC_SND_SOC_AUGE_VAD=y

# aml_dhp_interface.ko
CONFIG_AMLOGIC_MEDIA_WRAPPER=y

# aml_uvm.ko
CONFIG_AMLOGIC_UVM=y
CONFIG_AMLOGIC_UVM_CORE=y
CONFIG_AMLOGIC_UVM_ALLOCATOR=y

# amlogic-dvb.ko
CONFIG_AMLOGIC_DVB_CONFIG=y
CONFIG_AMLOGIC_DVB_EXTERN=y
CONFIG_AMLOGIC_AUCPU=y
CONFIG_AMLOGIC_DVB_DSM=y
CONFIG_AMLOGIC_SMARTCARD=y

# aml_media.ko
CONFIG_AMLOGIC_MEDIA_MODULE=y

# typec-mux-meson.ko (media depends on)
CONFIG_TYPEC_MUX_MESON=y
```

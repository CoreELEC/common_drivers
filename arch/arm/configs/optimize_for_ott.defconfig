## arch/arm/configs/optimize_for_ott.defconfig
```kconfig
# maybe can remove in OTT project
# aml_media.ko
CONFIG_AMLOGIC_VOUT3_SERVE=n
CONFIG_AMLOGIC_LCD=n
CONFIG_AMLOGIC_LCD_EXTERN_I2C_OLED=n
CONFIG_AMLOGIC_DisplayPort_TX=n
CONFIG_AMLOGIC_BL_EXTERN=n
CONFIG_AMLOGIC_BL_LDIM=n
CONFIG_AMLOGIC_BL_LDIM_IW7027=n
CONFIG_AMLOGIC_BL_LDIM_BLMCU=n
CONFIG_AMLOGIC_AMBILIGHT=n
CONFIG_AMLOGIC_MEDIA_VRR=n
CONFIG_AMLOGIC_POST_PROCESS_MANAGER=n
CONFIG_AMLOGIC_PIC_DEC=n
CONFIG_AMLOGIC_V4L_VIDEO=n
CONFIG_AMLOGIC_VIDEOBUF2_ION=n
CONFIG_AMLOGIC_IONVIDEO=n
CONFIG_AMLOGIC_VIDEOQUEUE=n
CONFIG_AMLOGIC_MEDIA_TVIN_HDMI=n
CONFIG_AMLOGIC_MEDIA_TVIN_DSC_DEC=n
CONFIG_AMLOGIC_MEDIA_TVIN_AFE=n
CONFIG_AMLOGIC_MEDIA_TVIN_VBI=n
CONFIG_AMLOGIC_MEDIA_TVIN_AVDETECT=n
CONFIG_AMLOGIC_MEDIA_TVIN_BT656=n

# amlogic-dvb-ci.ko
CONFIG_AMLOGIC_DVB_CI=n

# amlogic-dvb-usb-cam.ko
CONFIG_AMLOGIC_USBCAM=n
```

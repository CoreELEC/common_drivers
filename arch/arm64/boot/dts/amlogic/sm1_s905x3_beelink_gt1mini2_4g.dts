#include "sm1_s905x3_4g_1gbit.dts"

/{
	model = "Beelink";
	coreelec-dt-id = "sm1_s905x3_beelink_gt1mini2_4g";
	amlogic-dt-id = "sm1_ac213_4g";
};

&amhdmitx {
	vend_data {
		vendor_name = "Beelink";
		product_desc = "GT1-Mini-2";
	};
};

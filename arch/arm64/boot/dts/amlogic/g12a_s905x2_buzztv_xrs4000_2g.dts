#include "g12a_s905x2_buzztv_xr4000_2g.dts"

/ {
	model = "BuzzTV XRS4000";
	coreelec-dt-id = "g12a_s905x2_buzztv_xrs4000_2g";
	/* must match aml_dt set by the vendor bootloader */
	amlogic-dt-id = "g12a_xrs-4000_2g";
};

&amhdmitx {
	vend_data {
		product_desc = "XRS4000";
	};
};

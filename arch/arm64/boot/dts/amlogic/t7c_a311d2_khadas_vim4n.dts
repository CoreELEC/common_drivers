#include "t7c_a311d2_an400_linux_drm_hdmitx_only_debian.dts"
#include "coreelec_t7c_common.dtsi"
#include "a311d2_khadas_vim4_base.dtsi"

/ {
	model = "Khadas VIM4N";
	coreelec-dt-id = "t7c_a311d2_khadas_vim4n";
	amlogic-dt-id = "t7c_a311d2_an400-8g";
};

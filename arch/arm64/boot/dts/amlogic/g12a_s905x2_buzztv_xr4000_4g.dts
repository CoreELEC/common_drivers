#include "g12a_s905x2_buzztv_xr4000_2g.dts"

/ {
	coreelec-dt-id = "g12a_s905x2_buzztv_xr4000_4g";
	/* must match aml_dt set by the vendor bootloader */
	amlogic-dt-id = "g12a_xr-4000_4g";

	memory@0 {
		linux,usable-memory = <0x0 0x0 0x0 0xf5700000>;
	};

	reserved-memory {
		logo_reserved:linux,meson-fb {
			reg = <0x0 0x7f800000 0x0 0x800000>;
		};
	};
};

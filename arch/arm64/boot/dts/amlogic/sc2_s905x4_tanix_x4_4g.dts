#include "sc2_s905x4_tanix_x4_2g.dts"

/ {
	model = "Tanix X4 4G";
	amlogic-dt-id = "sc2_s905x4_ah212-4g";
	coreelec-dt-id = "sc2_s905x4_tanix_x4_4g";

	memory@00000000 {
		linux,usable-memory = <0x0 0x000000 0x0 0xf0000000>;
	};
};

&drm_vpu {
	logo_addr = "0x7f800000";
};

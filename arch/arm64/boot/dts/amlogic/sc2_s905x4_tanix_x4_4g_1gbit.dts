#include "sc2_s905x4_tanix_x4_2g_1gbit.dts"

/ {
	model = "Tanix X4 4G 1000M";
	amlogic-dt-id = "sc2_s905x4_ah212-4g-1000M";
	coreelec-dt-id = "sc2_s905x4_tanix_x4_4g_1gbit";

	memory@00000000 {
		linux,usable-memory = <0x0 0x000000 0x0 0xf0000000>;
	};
};

&drm_vpu {
	logo_addr = "0x7f800000";
};
